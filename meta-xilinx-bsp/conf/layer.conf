## meta-xilinx-bsp/conf/layer.conf
```bitbake
# We have a conf and classes directory, add to BBPATH
BBPATH .= ":${LAYERDIR}"

# We have a packages directory, add to BBFILES
BBFILES += "${LAYERDIR}/recipes-*/*/*.bb"
BBFILES += "${LAYERDIR}/recipes-*/*/*.bbappend"

# Activate recipes that require XSCT only when meta-xilinx-tools is present
BBFILES_DYNAMIC += "xilinx-tools:${LAYERDIR}/dynamic-layers/xilinx-tools/recipes*/*/*.bb \
                    xilinx-tools:${LAYERDIR}/dynamic-layers/xilinx-tools/recipes*/*/*.bbappend \
                   "


BBFILE_COLLECTIONS += "xilinx"
BBFILE_PATTERN_xilinx = "^${LAYERDIR}/"
BBFILE_PRIORITY_xilinx = "5"

LAYERDEPENDS_xilinx = "core"

LAYERSERIES_COMPAT_xilinx = "dunfell gatesgarth"

BB_DANGLINGAPPENDS_WARNONLY ?= "1"

XILINX_RELEASE_VERSION = "v2020.2"
```
